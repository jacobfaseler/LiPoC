/**
 * @cliArgs --board "/ti/boards/MSP_EXP432P401R" --product "simplelink_msp432p4_sdk@3.40.01.02"
 * @versions {"tool":"1.11.0+2225"}
 */

/**
 * Import the modules used in this configuration.
 */
const ADC    = scripting.addModule("/ti/drivers/ADC", {}, false);
const ADC1   = ADC.addInstance();
const GPIO   = scripting.addModule("/ti/drivers/GPIO");
const GPIO1  = GPIO.addInstance();
const GPIO2  = GPIO.addInstance();
const GPIO3  = GPIO.addInstance();
const PWM    = scripting.addModule("/ti/drivers/PWM");
const PWM1   = PWM.addInstance();
const PWM2   = PWM.addInstance();
const PWM3   = PWM.addInstance();
const PWM4   = PWM.addInstance();
const Power  = scripting.addModule("/ti/drivers/Power");
const RTOS   = scripting.addModule("/ti/drivers/RTOS");
const Timer  = scripting.addModule("/ti/drivers/Timer");
const Timer1 = Timer.addInstance();
const Timer2 = Timer.addInstance();
const Timer3 = Timer.addInstance();
const Timer4 = Timer.addInstance();
const UART   = scripting.addModule("/ti/drivers/UART");
const UART1  = UART.addInstance();
const UART2  = UART.addInstance();

/**
 * Write custom configuration values to the imported modules.
 */
ADC1.$name              = "CONFIG_ADC_0";
ADC1.adc.adcPin.$assign = "boosterpack.24";

GPIO1.$hardware = system.deviceData.board.components.S1;
GPIO1.$name     = "CONFIG_GPIO_BUTTON0";

GPIO2.$hardware = system.deviceData.board.components.S2;
GPIO2.$name     = "CONFIG_GPIO_BUTTON1";

GPIO3.$hardware = system.deviceData.board.components.LED1_RED;
GPIO3.$name     = "CONFIG_GPIO_LED0";

PWM1.$name                = "CONFIG_PWM0";
PWM1.$hardware            = system.deviceData.board.components.LED2_RED;
PWM1.timer.pwmPin.$assign = "ball.16";

PWM2.$name                = "CONFIG_PWM1";
PWM2.$hardware            = system.deviceData.board.components.LED2_GREEN;
PWM2.timer.pwmPin.$assign = "ball.17";

PWM3.$name                = "CONFIG_PWM2";
PWM3.$hardware            = system.deviceData.board.components.LED2_BLUE;
PWM3.timer.pwmPin.$assign = "ball.18";

PWM4.$name = "CONFIG_PWM_DC";

Power.performanceLevel3.$name = "ti_drivers_power_PowerMSP432PerfLevels0";
Power.performanceLevel2.$name = "ti_drivers_power_PowerMSP432PerfLevels1";
Power.performanceLevel1.$name = "ti_drivers_power_PowerMSP432PerfLevels2";
Power.performanceLevel0.$name = "ti_drivers_power_PowerMSP432PerfLevels3";


Timer1.$name         = "CONFIG_TIMER0";
Timer1.timerType     = "32 Bits";
Timer1.timer.$assign = "TIMER32_0";

Timer2.$name         = "CONFIG_TIMER1";
Timer2.timerType     = "32 Bits";
Timer2.timer.$assign = "TIMER32_1";

Timer3.$name         = "CONFIG_TIMER2";
Timer3.timer.$assign = "Timer_A2";

Timer4.$name         = "CONFIG_TIMER3";
Timer4.timer.$assign = "Timer_A3";

UART1.$hardware = system.deviceData.board.components.XDS110UART;
UART1.$name     = "CONFIG_UART0";

UART2.$name        = "CONFIG_UART1";
UART2.uart.$assign = "EUSCI_A1";

/**
 * Pinmux solution for unlocked pins/peripherals. This ensures that minor changes to the automatic solver in a future
 * version of the tool will not impact the pinmux you originally saw.  These lines can be completely deleted in order to
 * re-solve from scratch.
 */
ADC1.adc.$suggestSolution             = "ADC14";
GPIO1.gpioPin.$suggestSolution        = "ball.5";
GPIO2.gpioPin.$suggestSolution        = "ball.8";
GPIO3.gpioPin.$suggestSolution        = "ball.4";
PWM1.timer.$suggestSolution           = "Timer_A1";
PWM2.timer.$suggestSolution           = "Timer_A1";
PWM3.timer.$suggestSolution           = "Timer_A1";
PWM4.timer.$suggestSolution           = "Timer_A1";
PWM4.timer.pwmPin.$suggestSolution    = "boosterpack.19";
RTOS.timer0.resource.$suggestSolution = "Timer_A0";
UART1.uart.$suggestSolution           = "EUSCI_A0";
UART1.uart.txPin.$suggestSolution     = "ball.7";
UART1.uart.rxPin.$suggestSolution     = "ball.6";
UART2.uart.txPin.$suggestSolution     = "boosterpack.38";
UART2.uart.rxPin.$suggestSolution     = "boosterpack.34";
